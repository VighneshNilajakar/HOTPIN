## hotpin_esp32_firmware/main/Kconfig.projbuild
```kconfig
menu "HotPin Network Configuration"

    config HOTPIN_SERVER_IP
        string "Server IP Address"
        default "172.24.158.58"
        help
            IP address of the Python WebSocket/HTTP server.
            This should be the IP where your main.py server is running.
            Example: 10.240.253.58 or 192.168.1.100

    config HOTPIN_SERVER_PORT
        int "Server Port"
        default 8000
        range 1 65535
        help
            Port number where the server is listening.
            Default is 8000 for the Python WebSocket/HTTP server.

    config HOTPIN_WIFI_SSID
        string "WiFi SSID"
        default "wifi"
        help
            SSID (network name) for the WiFi network.

    config HOTPIN_WIFI_PASSWORD
        string "WiFi Password"
        default "123456780"
        help
            Password for the WiFi network.

    config HOTPIN_SESSION_ID
        string "WebSocket Session ID"
        default "esp32-cam-hotpin"
        help
            Unique session identifier for WebSocket connection.
            This helps the server identify different ESP32-CAM devices.

    config HOTPIN_AUTH_TOKEN
        string "API Authentication Token"
        default "your_api_token_here"
        help
            Bearer token for API authentication (if required by server).
            Leave as default if server doesn't require authentication.

endmenu
```

## hotpin_esp32_firmware/sdkconfig.defaults
```kconfig
# ESP32 Default Configuration
# This file contains critical configuration overrides for the HotPin firmware

# ===========================
# CPU Configuration
# ===========================
CONFIG_ESP_DEFAULT_CPU_FREQ_MHZ_240=y
CONFIG_ESP_DEFAULT_CPU_FREQ_MHZ=240

# ===========================
# PSRAM (External RAM) - CRITICAL
# ===========================
CONFIG_SPIRAM=y
CONFIG_SPIRAM_BOOT_INIT=y
CONFIG_SPIRAM_USE_MALLOC=y
CONFIG_SPIRAM_TYPE_AUTO=y
CONFIG_SPIRAM_SPEED_40M=y
CONFIG_SPIRAM_MALLOC_ALWAYSINTERNAL=16384
CONFIG_SPIRAM_MALLOC_RESERVE_INTERNAL=32768

# ===========================
# Memory Management
# ===========================


# ===========================
# Camera Configuration
# ===========================
CONFIG_CAMERA_CORE0=n
CONFIG_CAMERA_CORE1=y
CONFIG_CAMERA_DMA_BUFFER_SIZE_MAX=32768

# ===========================
# I2S Configuration (CRITICAL for Audio)
# ===========================
# Enable I2S ISR in IRAM to prevent failures during flash operations
CONFIG_I2S_ISR_IRAM_SAFE=y
# Prevent I2S DMA buffer corruption
CONFIG_I2S_SUPPRESS_DEPRECATE_WARN=y

# ===========================
# FreeRTOS Configuration
# ===========================
CONFIG_FREERTOS_HZ=1000
CONFIG_FREERTOS_UNICORE=n
CONFIG_FREERTOS_USE_TRACE_FACILITY=y
CONFIG_FREERTOS_USE_STATS_FORMATTING_FUNCTIONS=y
CONFIG_FREERTOS_VTASKLIST_INCLUDE_COREID=y

# ===========================
# WiFi Configuration
# ===========================
CONFIG_ESP_WIFI_AMPDU_TX_ENABLED=y
CONFIG_ESP_WIFI_AMPDU_RX_ENABLED=y
CONFIG_ESP_WIFI_NVS_ENABLED=y

# ===========================
# Task Watchdog
# ===========================
CONFIG_ESP_TASK_WDT_INIT=y
CONFIG_ESP_TASK_WDT_PANIC=n
CONFIG_ESP_TASK_WDT_TIMEOUT_S=10

# ===========================
# Brownout Detector (Disabled for stability)
# ===========================
CONFIG_ESP_BROWNOUT_DET=n

# ===========================
# Logging Configuration
# ===========================
CONFIG_LOG_DEFAULT_LEVEL_INFO=y
CONFIG_LOG_MAXIMUM_LEVEL_VERBOSE=y
CONFIG_LOG_COLORS=y

# ===========================
# WebSocket Configuration
# ===========================
CONFIG_WS_BUFFER_SIZE=8192

# ===========================
# Partition Table
# ===========================
CONFIG_PARTITION_TABLE_CUSTOM=y
CONFIG_PARTITION_TABLE_CUSTOM_FILENAME="partitions.csv"
CONFIG_PARTITION_TABLE_FILENAME="partitions.csv"

# ===========================
# Compiler Optimizations
# ===========================
CONFIG_COMPILER_OPTIMIZATION_PERF=y
CONFIG_COMPILER_OPTIMIZATION_SIZE=y
```
